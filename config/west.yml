## config/west.yml
```yaml
manifest:
  defaults:
    revision: v0.3
  remotes:
    - name: zmkfirmware
      url-base: https://github.com/zmkfirmware
    - name: caksoylar
      url-base: https://github.com/caksoylar
    - name: urob
      url-base: https://github.com/urob
    - name: geeksville
      url-base: https://github.com/geeksville
  projects:
    - name: zmk
      remote: zmkfirmware
      import: app/west.yml
    - name: cirque-input-module
      remote: geeksville
      revision: toucan
    - name: zmk-rgbled-widget
      remote: caksoylar
      revision: main
    - name: zmk-unicode
      remote: urob
      revision: v0.3 # Should match ZMK release.
  self:
    path: config
```
